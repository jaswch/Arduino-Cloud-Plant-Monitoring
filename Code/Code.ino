/* 
  This code reads the value from the BMP280 temprature sensor and a soil moisture sensor
  (It is not neccessary to read air pressure of a plant but I'm doing it for fun XD )
  
  Circuit connections:
  
  BMP280 to Wemos D1 R1
  SCL - SCL
  SDA - SDA
  VCC - 3.3V
  GND - GND
  
  Soil Moisture Sensor to Wemos D1 R1
  VCC - 5V
  SIG - A0
  GND - GND
  
  Half of the code is auto generated by the Arduino cloud.

  The following variables are created in the cloud to read temprature, air pressure and soil moisture
  float cloud_airPressure;
  float cloud_temprature;
  int cloud_soilMoisture;
  
  By Jaswanth Venkata Sai Chennu on 31 DEC 2022
  modified 20 MAY 2023
*/

#include "thingProperties.h"
#include <Wire.h>
#include <Adafruit_BMP280.h>

Adafruit_BMP280 bmp;

void setup() {
  // Initialize serial and wait for port to open:
  Serial.begin(115200);
  // This delay gives the chance to wait for a Serial Monitor without blocking if none is found
  delay(1500); 

  // Defined in thingProperties.h
  initProperties();

  // Connect to Arduino IoT Cloud
  ArduinoCloud.begin(ArduinoIoTPreferredConnection);
  
  /*
     The following function allows you to obtain more information
     related to the state of network and IoT Cloud connection and errors
     the higher number the more granular information you’ll get.
     The default is 0 (only errors).
     Maximum is 4
 */
  setDebugMessageLevel(2);
  ArduinoCloud.printDebugInfo();
  while ( !Serial ) delay(100);   // wait for native usb
  Serial.println(F("BMP280 test"));
  unsigned status;
  //status = bmp.begin(BMP280_ADDRESS_ALT, BMP280_CHIPID);
  status = bmp.begin(0x76);
  if (!status) {
    Serial.println(F("Could not find a valid BMP280 sensor, check wiring or "
                      "try a different address!"));
    Serial.print("SensorID was: 0x"); Serial.println(bmp.sensorID(),16);
    Serial.print("        ID of 0xFF probably means a bad address, a BMP 180 or BMP 085\n");
    Serial.print("        ID of 0x56-0x58 represents a BMP 280,\n");
    Serial.print("        ID of 0x60 represents a BME 280.\n");
    Serial.print("        ID of 0x61 represents a BME 680.\n");
    while (1) delay(10);
  }

  /* Default settings from datasheet. */
  bmp.setSampling(Adafruit_BMP280::MODE_NORMAL,     /* Operating Mode. */
                  Adafruit_BMP280::SAMPLING_X2,     /* Temp. oversampling */
                  Adafruit_BMP280::SAMPLING_X16,    /* Pressure oversampling */
                  Adafruit_BMP280::FILTER_X16,      /* Filtering. */
                  Adafruit_BMP280::STANDBY_MS_500); /* Standby time. */
}

void loop() {
  ArduinoCloud.update();
  
  cloud_soilMoisture = analogRead(A0); //Read the soil moisture
  cloud_temprature = bmp.readTemperature(); //Read the temprature
  cloud_airPressure = bmp.readPressure(); //Read the air pressure
}
